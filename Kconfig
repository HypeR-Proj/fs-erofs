## Kconfig
```kconfig
# SPDX-FileCopyrightText: 2026 roolrz
# SPDX-License-Identifier: Apache-2.0

config SYSTEM_APP_FS_EROFS_SYSTEM
    bool "fs-erofs-system (/svc/fs-erofs)"
    default y
    depends on SYSTEM_APP_FS_BACKEND_SYSTEM
    help
        Build and deploy hyper-fs-erofs-system at /svc/fs-erofs.
```
